// SPDX-License-Identifier: GPL-2.0+
/*
 * Copyright (C) 2020 SEAL AG
 */

#include "imx6ull-u-boot.dtsi"

&pinctrl_uart4 {
	u-boot,dm-spl;
};

&pinctrl_usdhc2 {
	u-boot,dm-spl;
};

&uart4 {
	u-boot,dm-spl;
};

&usdhc2 {
	u-boot,dm-spl;
};
